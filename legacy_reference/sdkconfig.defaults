## legacy_reference/sdkconfig.defaults
```kconfig
FW_BUILD = 52
CONFIG_MBEDTLS_SSL_IN_CONTENT_LEN=2048
CONFIG_MBEDTLS_SSL_OUT_CONTENT_LEN=2048
```

## sdkconfig.defaults
```kconfig
# Target
CONFIG_IDF_TARGET="esp32s3"

# FreeRTOS
CONFIG_FREERTOS_HZ=1000

# Watchdog
CONFIG_ESP_TASK_WDT_EN=y
CONFIG_ESP_TASK_WDT_TIMEOUT_S=5

# Serial flasher
CONFIG_ESPTOOLPY_MONITOR_BAUD=115200

# PSRAM - HABILITADO (hardware ESP32-S3-N8R8 tiene 8MB)
CONFIG_ESP32S3_SPIRAM_SUPPORT=y
CONFIG_SPIRAM_SIZE=8388608
CONFIG_SPIRAM_USE_CAPS_ALLOC=y
CONFIG_SPIRAM_MEMTEST=y
CONFIG_SPIRAM_CACHE_WORKAROUND=y
CONFIG_SPIRAM_BANKSWITCH_ENABLE=y
CONFIG_SPIRAM_BANKSWITCH_RESERVE=0
CONFIG_SPIRAM_ALLOW_BSS_SEG_EXTERNAL_MEMORY=n
CONFIG_SPIRAM_ALLOW_NOINIT_SEG_EXTERNAL_MEMORY=n
CONFIG_SPIRAM_OCCUPY_HSPI_HOST=y
CONFIG_SPIRAM_2T_MODE=y
CONFIG_SPIRAM_MODE_QUAD=n
CONFIG_SPIRAM_TYPE_ESPPSRAM64=y

# Heap
CONFIG_HEAP_POISONING_DISABLED=y
CONFIG_HEAP_TRACING_OFF=y

# Logging
CONFIG_LOG_DEFAULT_LEVEL_INFO=y
CONFIG_LOG_DEFAULT_LEVEL=3

# Optimización
CONFIG_COMPILER_OPTIMIZATION_PERF=y

# Security - NO eFuse
CONFIG_SECURE_BOOT=n
CONFIG_SECURE_BOOT_V2_ENABLED=n
CONFIG_SECURE_FLASH_ENC_ENABLED=n
CONFIG_EFUSE_CUSTOM_TABLE=n

# LittleFS
CONFIG_ESP_LITTLEFS_FS_SIZE=0x100000
CONFIG_ESP_LITTLEFS_FS_PAGE_SIZE=256
CONFIG_ESP_LITTLEFS_FS_BLOCK_SIZE=4096
CONFIG_ESP_LITTLEFS_MTIME_USE_SECONDS=y

# Use custom partition table for device with 8MB flash
CONFIG_PARTITION_TABLE_CUSTOM=y
CONFIG_PARTITION_TABLE_CUSTOM_FILENAME="partitions.csv"
CONFIG_PARTITION_TABLE_FILENAME="partitions.csv"

# Flash size for target hardware
CONFIG_ESPTOOLPY_FLASHSIZE="8MB"
# Prefer explicit flash size symbol
CONFIG_ESPTOOLPY_FLASHSIZE_8MB=y

# LittleFS tuning (fallback generic settings)
CONFIG_LITTLEFS_CACHE_SIZE=512
CONFIG_LITTLEFS_READ_SIZE=256
CONFIG_LITTLEFS_WRITE_SIZE=256
CONFIG_LITTLEFS_BLOCK_SIZE=4096
```
